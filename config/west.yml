## config/west.yml
```yaml
manifest:
  remotes:
    - name: zmkfirmware
      url-base: https://github.com/zmkfirmware
    - name: badjeff
      url-base: https://github.com/badjeff
    - name: nickcoutsos
      url-base: https://github.com/nickcoutsos
  projects:
    - name: zmk
      remote: zmkfirmware
      revision: main
      import: app/west.yml
    - name: zmk-pmw3610-driver
      remote: badjeff
      revision: main
    - name: keyboardio-nicenano
      remote: nickcoutsos
      revision: main
      path: modules/nicenano
  self:
    path: config
```
